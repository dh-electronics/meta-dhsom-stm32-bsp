## conf/distro/dhlinux.conf
```bitbake
# Distribution definition for: dhlinux
#
# Copyright (c) 2019 Marek Vasut <marex@denx.de>
#
# This file is released under the MIT license as described in
# ../meta/COPYING.MIT.
#
# The dhlinux distribution is intended to define a Linux system
# trimmed down to work well with the STM32MP1 boards.

DISTRO = "dhlinux"
DISTRO_NAME = "DH STM32MP1 Linux Distribution"
DISTRO_VERSION = "0.0.1"
DISTRO_CODENAME = "alpha"

MAINTAINER = "Marek Vasut <marex@denx.de>"

TARGET_VENDOR = "-dhlinux"

LOCALCONF_VERSION = "1"

DISTRO_VERSION[vardepsexclude] = "DATE"
SDK_VERSION[vardepsexclude] = "DATE"

DISTRO_FEATURES = "alsa argp ext2 largefile usbgadget usbhost xattr nfs pci ipv4 largefile opengl pulseaudio systemd ${DISTRO_FEATURES_LIBC} wayland wifi bluetooth bluez5 pam "
DISTRO_FEATURES_BACKFILL_CONSIDERED += "sysvinit"
VIRTUAL-RUNTIME_init_manager = "systemd"

SDK_NAME = "${DISTRO}-${TCLIBC}-${SDK_ARCH}-${IMAGE_BASENAME}-${TUNE_PKGARCH}"
SDKPATH = "/opt/${DISTRO}/${SDK_VERSION}"

DISTRO_EXTRA_RDEPENDS += " packagegroup-core-boot "

TCLIBCAPPEND = ""

PREMIRRORS ??= "\
bzr://.*/.*   http://downloads.yoctoproject.org/mirror/sources/ \n \
cvs://.*/.*   http://downloads.yoctoproject.org/mirror/sources/ \n \
git://.*/.*   http://downloads.yoctoproject.org/mirror/sources/ \n \
gitsm://.*/.* http://downloads.yoctoproject.org/mirror/sources/ \n \
hg://.*/.*    http://downloads.yoctoproject.org/mirror/sources/ \n \
osc://.*/.*   http://downloads.yoctoproject.org/mirror/sources/ \n \
p4://.*/.*    http://downloads.yoctoproject.org/mirror/sources/ \n \
svn://.*/.*   http://downloads.yoctoproject.org/mirror/sources/ \n"

MIRRORS =+ "\
ftp://.*/.*      http://downloads.yoctoproject.org/mirror/sources/ \n \
http://.*/.*     http://downloads.yoctoproject.org/mirror/sources/ \n \
https://.*/.*    http://downloads.yoctoproject.org/mirror/sources/ \n"

# The CONNECTIVITY_CHECK_URI's are used to test whether we can succesfully
# fetch from the network (and warn you if not). To disable the test set
# the variable to be empty.
# Git example url: git://git.yoctoproject.org/yocto-firewall-test;protocol=git;rev=master
CONNECTIVITY_CHECK_URIS ?= "https://www.example.com/"

SANITY_TESTED_DISTROS ?= " \
            debian-9 \n \
            "
#
# OELAYOUT_ABI allows us to notify users when the format of TMPDIR changes in
# an incompatible way. Such changes should usually be detailed in the commit
# that breaks the format and have been previously discussed on the mailing list
# with general agreement from the core team.
#
OELAYOUT_ABI = "12"

# QA check settings - a little stricter than the OE-Core defaults
WARN_TO_ERROR_QA = "already-stripped compile-host-path install-host-path \
                    installed-vs-shipped ldflags pn-overrides rpaths staticdev \
                    useless-rpaths"
WARN_QA_remove = "${WARN_TO_ERROR_QA}"
ERROR_QA_append = " ${WARN_TO_ERROR_QA}"

require conf/distro/include/no-static-libs.inc
require conf/distro/include/yocto-uninative.inc
INHERIT += "uninative"
```

## conf/layer.conf
```bitbake
# We have a conf and classes directory, add to BBPATH
BBPATH .= ":${LAYERDIR}"

# We have a packages directory, add to BBFILES
BBFILES += "${LAYERDIR}/recipes-*/*/*.bb"
BBFILES += "${LAYERDIR}/recipes-*/*/*.bbappend"

BBFILE_COLLECTIONS += "dhsomstm32bsp"
BBFILE_PATTERN_dhsomstm32bsp = "^${LAYERDIR}/"
BBFILE_PRIORITY_dhsomstm32bsp = "5"

LAYERDEPENDS_dhsomstm32bsp = "core mainlinecommon-layer"
LAYERSERIES_COMPAT_dhsomstm32bsp = "dunfell kirkstone"

BBFILES_DYNAMIC += " \
	qt4-layer:${LAYERDIR}/dynamic-layers/qt4-layer/*/*/*.bb \
	qt4-layer:${LAYERDIR}/dynamic-layers/qt4-layer/*/*/*.bbappend \
	"
```

## conf/machine/dh-stm32mp1-dhcom-drc02.conf
```bitbake
#@TYPE: Machine
#@NAME: DH STM32MP1 DHCOM SoM on DRC02 carrier board
#@SOC:  ST STM32MP1
#@DESCRIPTION: Machine configuration for DH STM32MP1 DHCOM SoM on DRC02 carrier board

require conf/machine/include/dh-stm32mp1-common.inc

# U-Boot bootloader
UBOOT_MACHINE = "stm32mp15_dhcom_basic_defconfig"

# Linux kernel
KERNEL_DEVICETREE = " \
	stm32mp153c-dhcom-drc02.dtb \
	stm32mp15xx-dhcom-drc02-overlay-wifi-rsi.dtbo \
	"

# Ship kernel modules
MACHINE_ESSENTIAL_EXTRA_RDEPENDS += " linux-firmware-rs9116 "
KERNEL_MODULE_AUTOLOAD += " rsi_sdio "
KERNEL_MODULE_PROBECONF += " rsi_sdio "
module_conf_rsi_sdio = "options rsi_sdio dev_oper_mode=1"
```

## conf/machine/dh-stm32mp1-dhcom-pdk2.conf
```bitbake
#@TYPE: Machine
#@NAME: DH STM32MP1 DHCOM SoM on PDK2 carrier board
#@SOC:  ST STM32MP1
#@DESCRIPTION: Machine configuration for DH STM32MP1 DHCOM SoM on PDK2 carrier board

require conf/machine/include/dh-stm32mp1-common.inc

# U-Boot bootloader
UBOOT_MACHINE = "stm32mp15_dhcom_basic_defconfig"

# Linux kernel
KERNEL_DEVICETREE = " \
	stm32mp157c-dhcom-pdk2.dtb \
	stm32mp15xx-dhcom-pdk2-overlay-460-200-x11.dtbo \
	stm32mp15xx-dhcom-pdk2-overlay-497-200-x12.dtbo \
	stm32mp15xx-dhcom-pdk2-overlay-531-100-x21.dtbo \
	stm32mp15xx-dhcom-pdk2-overlay-531-100-x22.dtbo \
	stm32mp15xx-dhcom-pdk2-overlay-505-200-x12-ch101olhlwh.dtbo \
	stm32mp15xx-dhcom-pdk2-overlay-560-200-x12.dtbo \
	stm32mp15xx-dhcom-pdk2-overlay-638-100-x12-rpi7inch.dtbo \
	stm32mp15xx-dhcom-pdk2-overlay-672-100-x18.dtbo \
	"

# Ship kernel modules
MACHINE_ESSENTIAL_EXTRA_RDEPENDS += " linux-firmware-rs9116 "
KERNEL_MODULE_AUTOLOAD += " rsi_sdio "
KERNEL_MODULE_PROBECONF += " rsi_sdio "
module_conf_rsi_sdio = "options rsi_sdio dev_oper_mode=1"
```

## conf/machine/dh-stm32mp1-dhcom-picoitx.conf
```bitbake
#@TYPE: Machine
#@NAME: DH STM32MP1 DHCOM SoM on PicoITX carrier board
#@SOC:  ST STM32MP1
#@DESCRIPTION: Machine configuration for DH STM32MP1 DHCOM SoM on PicoITX carrier board

require conf/machine/include/dh-stm32mp1-common.inc

# U-Boot bootloader
UBOOT_MACHINE = "stm32mp15_dhcom_basic_defconfig"

# Linux kernel
KERNEL_DEVICETREE = " \
	${KERNEL_DEVICETREE_PATH_PREFIX}stm32mp157c-dhcom-picoitx.dtb \
	${KERNEL_DEVICETREE_PATH_PREFIX}stm32mp15xx-dhcom-picoitx-overlay-548-200-x2-mi0700s4t-6.dtbo \
	${KERNEL_DEVICETREE_PATH_PREFIX}stm32mp15xx-dhcom-picoitx-overlay-553-100-x2-tst043015cmhx.dtbo \
	${KERNEL_DEVICETREE_PATH_PREFIX}stm32mp15xx-dhcom-picoitx-overlay-626-100-x2-ch101olhlwh.dtbo \
	"

# Ship kernel modules
MACHINE_ESSENTIAL_EXTRA_RDEPENDS += " linux-firmware-rs9116 "
KERNEL_MODULE_AUTOLOAD += " rsi_sdio "
KERNEL_MODULE_PROBECONF += " rsi_sdio "
module_conf_rsi_sdio = "options rsi_sdio dev_oper_mode=1"
```

## conf/machine/dh-stm32mp1-dhcor-avenger96.conf
```bitbake
#@TYPE: Machine
#@NAME: DH STM32MP1 DHCOR SoM on Avenger96 carrier board
#@SOC:  ST STM32MP1
#@DESCRIPTION: Machine configuration for DH STM32MP1 DHCOR SoM on Avenger96 carrier board

require conf/machine/include/dh-stm32mp1-common.inc

# U-Boot bootloader
UBOOT_MACHINE = "stm32mp15_dhcor_basic_defconfig"

# Linux kernel
KERNEL_DEVICETREE = " \
	stm32mp157a-avenger96.dtb \
	stm32mp15xx-avenger96-overlay-644-100-x6-otm8009a.dtbo \
	stm32mp15xx-avenger96-overlay-644-100-x6-rpi7inch.dtbo \
	stm32mp15xx-avenger96-overlay-fdcan1-x6.dtbo \
	stm32mp15xx-avenger96-overlay-fdcan2-x6.dtbo \
	stm32mp15xx-avenger96-overlay-i2c1-eeprom-x6.dtbo \
	stm32mp15xx-avenger96-overlay-i2c2-eeprom-x6.dtbo \
	stm32mp15xx-avenger96-overlay-ov5640-x7.dtbo \
	stm32mp15xx-avenger96-overlay-spi2-eeprom-x6.dtbo \
	"

# Ship kernel modules
MACHINE_ESSENTIAL_EXTRA_RDEPENDS += " \
	cypress-firmware-bcm43xx-bt-patch-bcm4345c0 \
	cypress-firmware-bcm43xx-fmac-fw-bcm43455-1mw-sdio \
	cypress-firmware-bcm43xx-fmac-nvram-bcm43455-1mw-sdio \
	"
```

## conf/machine/dh-stm32mp1-dhcor-testbench.conf
```bitbake
#@TYPE: Machine
#@NAME: DH STM32MP1 DHCOR SoM on Testbench carrier board
#@SOC:  ST STM32MP1
#@DESCRIPTION: Machine configuration for DH STM32MP1 DHCOR SoM on Testbench carrier board

require conf/machine/include/dh-stm32mp1-common.inc

# U-Boot bootloader
UBOOT_MACHINE = "stm32mp15_dhcor_basic_defconfig"

# Linux kernel
KERNEL_DEVICETREE = " \
	${KERNEL_DEVICETREE_PATH_PREFIX}stm32mp151a-dhcor-testbench.dtb \
	"
```

## conf/machine/dh-stm32mp13-dhcor-dhsbc.conf
```bitbake
#@TYPE: Machine
#@NAME: DH STM32MP13 DHCOR SoM on DHSBC carrier board
#@SOC:  ST STM32MP13
#@DESCRIPTION: Machine configuration for DH STM32MP13 DHCOR SoM on DHSBC carrier board

MACHINEOVERRIDES =. "dh-stm32mp13-dhsom:"

require conf/machine/include/dh-stm32mp1-common.inc

UBOOT_MAKE_TARGET := "u-boot-nodtb.bin u-boot.dtb all"
UBOOT_BINARY := "u-boot-nodtb.bin"
UBOOT_SUFFIX ?= "bin"
SPL_BINARY := ""
WKS_FILE = "emmcimage-stm32mp13.wks"
do_image_wic[depends] += "trusted-firmware-a:do_deploy"

# U-Boot bootloader
UBOOT_MACHINE = "stm32mp13_dhcor_defconfig"

# Linux kernel
KERNEL_DEVICETREE = " \
	st/stm32mp135f-dhcor-dhsbc.dtb \
	st/stm32mp13xx-dhcor-dhsbc-overlay-rb-tft32-v2.dtbo \
	"

# Ship kernel modules
MACHINE_ESSENTIAL_EXTRA_RDEPENDS += " \
	cypress-firmware-bcm43xx-bt-patch-bcm4343a2 \
	cypress-firmware-bcm43xx-fmac-nvram-bcm43439-1yn-sdio \
	ifx-firmware-bcm43xx-fmac-fw-bcm43439-sdio \
	"
```

## conf/machine/include/dh-stm32mp1-common.inc
```bitbake
DEFAULTTUNE ?= "cortexa7thf-neon-vfpv4"
SOC_FAMILY ?= "stm32mp1"

MACHINEOVERRIDES =. "dh-dhsom:dh-stm32mp-dhsom:dh-stm32mp1-dhsom:"

ARM_INSTRUCTION_SET = "thumb"

require conf/machine/include/arm/armv7a/tune-cortexa7.inc
require conf/machine/include/soc-family.inc

MACHINE_FEATURES ?= "apm alsa ext2 keyboard mainline screen serial touchscreen usbgadget usbhost"

SERIAL_CONSOLES = "115200;ttySTM0"

# U-Boot bootloader
UBOOT_ENTRYPOINT := "0xc4000000"
UBOOT_MAKE_TARGET := "all"
UBOOT_BINARY := "u-boot.itb"
UBOOT_SUFFIX ?= "itb"
SPL_BINARY := "u-boot-spl.stm32"
UBOOT_ENV = "boot"
UBOOT_ENV_SUFFIX = "scr"
# fitImage DT and DTO load addresses
UBOOT_DTB_LOADADDRESS = "0xcff00000"
UBOOT_DTBO_LOADADDRESS = "0xcff80000"

PREFERRED_PROVIDER_virtual/bootloader ?= "u-boot-mainline"
PREFERRED_PROVIDER_u-boot ?= "u-boot-mainline"
PREFERRED_PROVIDER_u-boot-native ?= "u-boot-mainline"
PREFERRED_PROVIDER_u-boot-fw-utils ?= "u-boot-mainline-fw-utils"
PREFERRED_PROVIDER_u-boot-fw-utils-native ?= "u-boot-mainline-fw-utils-native"
PREFERRED_PROVIDER_u-boot-mkimage-native ?= "u-boot-mainline-tools-native"
PREFERRED_PROVIDER_u-boot-tools ?= "u-boot-mainline-tools"
PREFERRED_PROVIDER_u-boot-tools-native ?= "u-boot-mainline-tools-native"
PREFERRED_VERSION_u-boot-mainline ?= "2025.01%"
PREFERRED_VERSION_u-boot-mainline-native ?= "2025.01%"
PREFERRED_VERSION_u-boot-mainline-fw-utils ?= "2025.01%"
PREFERRED_VERSION_u-boot-mainline-fw-utils-native ?= "2025.01%"
PREFERRED_VERSION_u-boot-mainline-tools ?= "2025.01%"
PREFERRED_VERSION_u-boot-mainline-tools-native ?= "2025.01%"

# Linux kernel
KERNEL_IMAGETYPE = "fitImage"
KERNEL_CLASSES += " kernel-fitimage "
KERNEL_MODULES_AUTOLOAD += " etnaviv "

PREFERRED_PROVIDER_virtual/kernel ?= "linux-stable"
PREFERRED_VERSION_linux-stable ?= "6.12%"
KERNEL_DEVICETREE_PATH_PREFIX = "${@'st/' if (d.getVar('PREFERRED_VERSION_linux-stable') in ["6.6%", "6.12%"]) else ''}"
KERNEL_DTBVENDORED = "0"
KERNEL_DTC_FLAGS += "-@"

# Mesa
PREFERRED_PROVIDER_virtual/egl ?= "mesa-mainline"
PREFERRED_PROVIDER_virtual/libgl ?= "mesa-mainline"
PREFERRED_PROVIDER_virtual/libgles1 ?= "mesa-mainline"
PREFERRED_PROVIDER_virtual/libgles2 ?= "mesa-mainline"
PREFERRED_PROVIDER_virtual/libgles3 ?= "mesa-mainline"
PREFERRED_PROVIDER_virtual/mesa ?= "mesa-mainline"
PREFERRED_PROVIDER_drm ?= "libdrm-mainline"
PREFERRED_PROVIDER_libdrm ?= "libdrm-mainline"
PREFERRED_PROVIDER_nativesdk-libdrm ?= "nativesdk-libdrm-mainline"
PREFERRED_PROVIDER_wayland-protocols ?= "wayland-protocols-mainline"
PREFERRED_PROVIDER_nativesdk-wayland-protocols ?= "nativesdk-wayland-protocols-mainline"

# WPE (from meta-webkit)
PREFERRED_RPROVIDER_virtual/wpebackend ?= "wpebackend-fdo"

# Ship kernel modules
MACHINE_ESSENTIAL_EXTRA_RDEPENDS += " kernel-modules kernel-devicetree u-boot-default-env "

# List of images to be built
IMAGE_FSTYPES ?= "tar.zst wic.zst wic.gz wic.bmap"
INITRAMFS_FSTYPES ?= "cpio.zst"

EXTRA_IMAGEDEPENDS += "u-boot-mainline"
WKS_FILE = "sdimage-stm32mp1.wks"
IMAGE_BOOT_FILES ?= "${KERNEL_IMAGETYPE}"
IMAGE_INSTALL:append = " kernel-devicetree kernel-image-fitimage u-boot-mainline "
do_image_wic[depends] += "mtools-native:do_populate_sysroot dosfstools-native:do_populate_sysroot u-boot-mainline:do_deploy"

# Add any optional config files that might be present e.g. in other layers
include conf/machine/include/dh-stm32mp1-common-extra.inc
include conf/machine/${MACHINE}-extra.conf
```

## conf/machine/mainlinestm32mp1.conf
```bitbake
#@TYPE: Machine
#@NAME: Mainline STM32MP1
#@SOC:  ST STM32MP1
#@DESCRIPTION: Machine configuration for Mainline STM32MP1

DEFAULTTUNE ?= "cortexa7thf-neon-vfpv4"
SOC_FAMILY ?= "stm32mp1"

ARM_INSTRUCTION_SET = "thumb"

require conf/machine/include/tune-cortexa7.inc
require conf/machine/include/soc-family.inc

MACHINE_FEATURES ?= "apm alsa ext2 keyboard screen serial touchscreen usbgadget usbhost"

SERIAL_CONSOLE = "115200 ttySTM0"

# U-Boot bootloader
UBOOT_ENTRYPOINT := "0xc4000000"
UBOOT_MACHINE = "stm32mp15_dhcom_basic_defconfig"
UBOOT_BINARY := "u-boot.img"
UBOOT_SUFFIX ?= "img"
SPL_BINARY := "u-boot-spl.stm32"
UBOOT_ENV = "boot"
UBOOT_ENV_SUFFIX = "scr"

PREFERRED_VERSION_u-boot ?= "2020.01%"
PREFERRED_VERSION_u-boot-mkimage ?= "2020.01%"

# Linux kernel
KERNEL_IMAGETYPE = "fitImage"
KERNEL_CLASSES += " kernel-fitimage "
KERNEL_DEVICETREE = "stm32mp157c-dhcom-pdk2.dtb"
KERNEL_MODULES_AUTOLOAD += " etnaviv "

PREFERRED_PROVIDER_virtual/kernel = "linux-stable"
PREFERRED_VERSION_linux-yocto = "5.4%"

# Ship kernel modules
MACHINE_ESSENTIAL_EXTRA_RDEPENDS = "kernel-modules kernel-devicetree linux-firmware-rs9116 u-boot"

# List of images to be built
IMAGE_FSTYPES ?= "tar.xz wic.xz"
INITRAMFS_FSTYPES ?= "cpio.xz"

WKS_FILE = "sdimage-mainlinestm32mp1.wks"
IMAGE_BOOT_FILES ?= "${KERNEL_IMAGETYPE}"
IMAGE_INSTALL_append = " kernel-devicetree kernel-image-fitimage u-boot"
do_image_wic[depends] += "mtools-native:do_populate_sysroot dosfstools-native:do_populate_sysroot u-boot:do_deploy"
```

## files/wic/emmcimage-stm32mp13.wks
```
# short-description: Create DH STM32MP13 eMMCcard image with a boot partition
# long-description: Creates a partitioned eMMC card image. Boot files
# are located in the first ext4 partition.

part fip --source rawcopy --part-name=fip --sourceparams="file=${DEPLOY_DIR_IMAGE}/fip.bin-stm32mp1" --ondisk mmcblk --align 1 --size 4M
part / --source rootfs --ondisk mmcblk0 --fstype=ext4 --label root --part-name "rootfs" --align 4096 --use-uuid --active

bootloader --ptable gpt
```

## files/wic/sdimage-stm32mp1.wks
```
# short-description: Create DH STM32MP1 SD card image with a boot partition
# long-description: Creates a partitioned SD card image. Boot files
# are located in the first ext4 partition.

part fsbl1 --source rawcopy --sourceparams="file=u-boot-spl.stm32" --part-name "fsbl1" --ondisk mmcblk --align 1 --size 256k
part fsbl2 --source rawcopy --sourceparams="file=u-boot-spl.stm32" --part-name "fsbl2" --ondisk mmcblk --align 1 --size 256k
part ssbl --source rawcopy --sourceparams="file=u-boot.itb" --part-name "ssbl" --ondisk mmcblk --align 1 --size 2M
part / --source rootfs --ondisk mmcblk0 --fstype=ext4 --label root --part-name "rootfs" --align 4096 --use-uuid --active

bootloader --ptable gpt
```

## scripts/lib/wic/canned-wks/emmcimage-stm32mp13.wks
```
# short-description: Create DH STM32MP13 eMMCcard image with a boot partition
# long-description: Creates a partitioned eMMC card image. Boot files
# are located in the first ext4 partition.

part / --source rootfs --ondisk mmcblk0 --fstype=ext4 --label root --part-name "rootfs" --align 4096 --use-uuid --active

bootloader --ptable gpt
```
